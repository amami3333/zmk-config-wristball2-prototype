## config/west.yml
```yaml
manifest:
  remotes:
    - name: zmkfirmware
      url-base: https://github.com/zmkfirmware
    - name: gohanda11
      url-base: https://github.com/gohanda11
  projects:
    - name: zmk
      remote: zmkfirmware
      revision: v0.3.0   # ← main からここを変更（安定版）
      import: app/west.yml
    - name: zmk-pmw3610-driver-wristball2
      remote: gohanda11
      revision: main     # カスタムモジュールは一旦mainのまま（v0.3対応タグがあれば変えてください）
    - name: zmk-rgbled-widget
      remote: gohanda11
      revision: main     # 同上
  self:
    path: config
```
